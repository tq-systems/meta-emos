## conf/distro/emos.conf
```bitbake
DISTRO = "emos"
DISTROOVERRIDES = "emos"
DISTRO_NAME = "EMOS"
DISTRO_VERSION = "snapshot-${DATE}"

SDK_VERSION := "${DISTRO_VERSION}"

#MAINTAINER = ""

LOCALCONF_VERSION = "1"

SDK_NAME = "${DISTRO}-${SDK_ARCH}-${TUNE_PKGARCH}"

TCLIBC = "glibc"
TCLIBCAPPEND = ""

VOLATILE_BINDS = "\
    /var/volatile/cache /var/cache\n\
    /var/volatile/lib /var/lib\n\
"
VOLATILE_LOG_DIR = "no"
INHERIT += "package-rm-var-log"
DEPLOY_DIR_EMPKG = "${DEPLOY_DIR}/apps"

DISTRO_FEATURES = "largefile rauc seccomp zeroconf dbus"

INIT_MANAGER = "systemd"
VIRTUAL-RUNTIME_initscripts = ""

USERADDEXTENSION = "useradd-staticids"
USERADD_UID_TABLES = "files/emos/passwd"
USERADD_GID_TABLES = "files/emos/group"
USERADD_ERROR_DYNAMIC = "error"

RDEPENDS:${KERNEL_PACKAGE_NAME}-base = ""

PACKAGECONFIG:pn-jq = ""
PACKAGECONFIG:pn-jq-native = ""

PACKAGECONFIG:pn-libsolv = ""

PACKAGECONFIG:remove:pn-mosquitto = "dlt"

PACKAGECONFIG:remove:pn-rauc = "streaming network"

PACKAGECONFIG:pn-nftables = "readline json"

PACKAGECONFIG:pn-libgpiod = "dbus"

PACKAGECONFIG:pn-glib-2.0 = "libmount"

PREFERRED_VERSION_libmodbus = "3.1.%"

RAUC_EXAMPLE_KEY_FILE = "${@bb.utils.which(d.getVar('BBPATH'), 'files/emos/rauc/key.pem')}"
RAUC_EXAMPLE_CERT_FILE = "${@bb.utils.which(d.getVar('BBPATH'), 'files/emos/rauc/ca.cert.pem')}"
RAUC_EXAMPLE_KEYRING_FILE = "${RAUC_EXAMPLE_CERT_FILE}"

RAUC_KEY_FILE ?= "${RAUC_EXAMPLE_KEY_FILE}"
RAUC_CERT_FILE ?= "${RAUC_EXAMPLE_CERT_FILE}"
RAUC_KEYRING_FILE ?= "${RAUC_EXAMPLE_KEYRING_FILE}"

PREFERRED_RPROVIDER_virtual-rauc-conf ?= "emit"

require conf/distro/include/no-static-libs.inc
require conf/distro/include/yocto-uninative.inc
require conf/distro/include/security_flags.inc
INHERIT += "uninative"
```

## conf/layer.conf
```bitbake
# We have a conf and classes directory, add to BBPATH
BBPATH .= ":${LAYERDIR}"

# We have recipes-* directories, add to BBFILES
BBFILES += "${LAYERDIR}/recipes-*/*/*.bb \
	${LAYERDIR}/recipes-*/*/*.bbappend"

BBFILE_COLLECTIONS += "emos-layer"
BBFILE_PATTERN_emos-layer = "^${LAYERDIR}/"
BBFILE_PRIORITY_emos-layer = "8"

LAYERSERIES_COMPAT_emos-layer = "kirkstone"
LAYERDEPENDS_emos-layer = "core"
LAYERDEPENDS_emos-layer += "openembedded-layer meta-python multimedia-layer networking-layer webserver"
LAYERDEPENDS_emos-layer += "meta-python2"
LAYERDEPENDS_emos-layer += "rauc"

LICENSE_PATH += "${LAYERDIR}/files/custom-licenses"

FSL_EULA_FILE = "${LAYERDIR}/files/FSL-EULA"
FSL_MIRROR ?= "https://www.nxp.com/lgfiles/NMG/MAD/YOCTO/"

TI_COMMON_DEPLOY:emos = "${DEPLOY_DIR}"
```

## conf/machine/em-cb30-k3r5.conf
```bitbake
# SPDX-License-Identifier: MIT
#
# Copyright (C) 2024 TQ-Systems GmbH <oss@ew.tq-group.com>, D-82229 Seefeld, Germany.
# Author: Matthias Schiffer

#@TYPE: Machine
#@NAME: TQ-Systems EM-CB30 (R5)
#@SOC: AM62xx (R5)
#@DESCRIPTION: Machine configuration for R5 bootloaders of TQ-Systems EM-CB30

MACHINEOVERRIDES =. "em-cb30-k3r5:"

# From meta-ti
require conf/machine/include/k3r5.inc

# The tiboot3.bin filename is built from these variables. The sysfw
# configuration can be adjusted in the U-Boot source.
SYSFW_SOC = "am62x"
SYSFW_CONFIG = "evm"
SYSFW_SUFFIX = "hs-fs"

PREFERRED_PROVIDER_virtual/bootloader = "u-boot-em"
PREFERRED_PROVIDER_u-boot = "u-boot-em"

UBOOT_BINARY = "spl/u-boot-spl.${UBOOT_SUFFIX}"

UBOOT_CONFIG = "512m 1g 2g"
UBOOT_CONFIG[512m] = "EM-CB30-512M_r5_defconfig"
UBOOT_CONFIG[1g] = "EM-CB30-1G_r5_defconfig"
UBOOT_CONFIG[2g] = "EM-CB30-2G_r5_defconfig"
```

## conf/machine/em-cb30.conf
```bitbake
# SPDX-License-Identifier: MIT
#
# Copyright (C) 2024 TQ-Systems GmbH <oss@ew.tq-group.com>, D-82229 Seefeld, Germany.
# Author: Matthias Schiffer

#@TYPE: Machine
#@NAME: TQ-Systems EM-CB30
#@SOC: AM62xx
#@DESCRIPTION: Machine configuration for bootloaders of TQ-Systems EM-CB30

MACHINEOVERRIDES =. "em-cb30:em:"

require conf/machine/include/am62xx.inc

PREFERRED_PROVIDER_virtual/kernel = "linux-dummy"
PREFERRED_PROVIDER_u-boot = "u-boot-em"
PREFERRED_PROVIDER_virtual/bootloader = "u-boot-em"

UBOOT_MACHINE = "EM-CB30_a53_defconfig"

UBOOT_SIGN_ENABLE = "0"

SPL_OFFSET_KB = "512"
UBOOT_OFFSET_KB = "2048"
BOOTPART_SIZE_KB = "4096"
```

## conf/machine/em300.conf
```bitbake
#@TYPE: Machine
#@NAME: TQ Energy Manager 300
#@SOC: i.MX28
#@DESCRIPTION: Machine configuration for TQ Energymanager 300
#@MAINTAINER: Christoph Krutz <christoph.krutz@tq-group.com>

MACHINEOVERRIDES =. "mxs:mx28:em:"

include conf/machine/include/tune-arm926ejs.inc

PREFERRED_PROVIDER_u-boot = "u-boot-fslc-em"
PREFERRED_PROVIDER_virtual/bootloader = "u-boot-fslc-em"
UBOOT_CONFIG = "em300"
UBOOT_CONFIG[em300] = "em300_config"

PREFERRED_PROVIDER_virtual/kernel = "linux-em"
KERNEL_DEVICETREE = "imx28-em300.dtb"

SERIAL_CONSOLES = "115200;ttyAMA0"

UBOOT_ENTRYPOINT_mxs = "0x40008000"
UBOOT_MAKE_TARGET_mxs = "u-boot.sb"
UBOOT_SUFFIX_mxs = "sb"

TQ_DEVICE_TYPE = "hw0001"

MACHINE_EXTRA_RRECOMMENDS += "imx28-blupdate"
```

## conf/machine/em310.conf
```bitbake
#@TYPE: Machine
#@NAME: TQ Energy Manager 310
#@SOC: i.MX28
#@DESCRIPTION: Machine configuration for TQ Energymanager 310
#@MAINTAINER: Christoph Krutz <christoph.krutz@tq-group.com>

MACHINEOVERRIDES =. "mxs:mx28:em:"

include conf/machine/include/arm/armv5/tune-arm926ejs.inc

PREFERRED_PROVIDER_u-boot = "u-boot-fslc-em"
PREFERRED_PROVIDER_virtual/bootloader = "u-boot-fslc-em"
UBOOT_CONFIG = "em310"
UBOOT_CONFIG[em310] = "em310_config"

PREFERRED_PROVIDER_virtual/kernel = "linux-em"
KERNEL_DEVICETREE = "nxp/mxs/imx28-em310.dtb"

SERIAL_CONSOLES = "115200;ttyAMA0"

UBOOT_MAKE_TARGET:mxs = "u-boot.sb"
UBOOT_SUFFIX:mxs = "sb"

TQ_DEVICE_TYPE = "hw0100"
TQ_PRODUCT_ID = '{"tq,em310": 18514}'

# tqs,energymanager310 is listed to support upgrades from pre-5.4 kernels
EM_BUNDLE_BOOTLOADER = "tq,em310:256m tqs,energymanager310:256m"
EM_BUNDLE_BOOTLOADER[tq_em310_256m] = "u-boot.sb"
EM_BUNDLE_BOOTLOADER[tqs_energymanager310_256m] = "u-boot.sb"

MACHINE_EXTRA_RRECOMMENDS += " \
	imx28-blupdate \
	eol-led \
	status-led \
	netdev-led \
	em-power-handler \
	teridiand-config \
	em-timesync \
	u-boot-default-env \
"
```

## conf/machine/em4xx.conf
```bitbake
# SPDX-License-Identifier: MIT
#
# Copyright (C) 2020-2024 TQ-Systems GmbH <oss@ew.tq-group.com>, D-82229 Seefeld, Germany.
# Author: Matthias Schiffer

#@TYPE: Machine
#@NAME: TQ EM4xx-CB
#@SOC: i.MX8M Nano
#@DESCRIPTION: Machine configuration for bootloaders of TQ Energymanager EM4xx Compute Board

require conf/machine/include/em-mx8mn.inc

PREFERRED_PROVIDER_virtual/kernel = "linux-dummy"

UBOOT_CONFIG = "1g 512m"
UBOOT_CONFIG[1g] = "imx8mn_em4xx_cb_1g_defconfig"
UBOOT_CONFIG[512m] = "imx8mn_em4xx_cb_512m_defconfig"

EXTRA_OEMAKE:append:pn-trusted-firmware-a = " IMX_BOOT_UART_BASE=0x30860000"
```

## conf/machine/imx8mn-egw.conf
```bitbake
#@TYPE: Machine
#@NAME: EEBUS-GW
#@SOC: i.MX8M Nano
#@DESCRIPTION: Machine configuration for EEBUS Gateway based on TQ Energymanager EM4xx CB
#@MAINTAINER: Michael Krummsdorf <michael.krummsdorf@tq-group.com>

require conf/machine/include/em-mx8mn.inc

UBOOT_CONFIG = "512m"
UBOOT_CONFIG[512m] = "imx8mn_egw_512m_defconfig"

PREFERRED_PROVIDER_virtual/kernel = "linux-em"
KERNEL_DEVICETREE = " \
	freescale/imx8mn-egw-l.dtb \
"
KERNEL_IMAGETYPE = "Image.gz"

# Set Serial console
SERIAL_CONSOLES = "115200;ttymxc0"
TQ_DEVICE_TYPE = "imx8mn-egw"

EM_BUNDLE_BOOTLOADER = "tq,egw:512m"
EM_BUNDLE_BOOTLOADER[tq_egw_512m] = "flash.bin-512m"

MACHINE_EXTRA_RRECOMMENDS += " \
	linux-firmware-imx-sdma-imx7d \
	u-boot-default-env \
"

EXTRA_OEMAKE:append:pn-trusted-firmware-a = " IMX_BOOT_UART_BASE=0x30860000"
```

## conf/machine/include/em-mx8mn.inc
```bitbake
# SPDX-License-Identifier: MIT
#
# Copyright (C) 2024 TQ-Systems GmbH <oss@ew.tq-group.com>, D-82229 Seefeld, Germany.
# Author: Matthias Schiffer
#
# Common definitions for meta-emos machines with i.MX8MN SoC


MACHINEOVERRIDES =. "mx8:mx8m:mx8mn:em:"

require conf/machine/include/arm/arch-arm64.inc

PREFERRED_PROVIDER_u-boot = "u-boot-em"
PREFERRED_PROVIDER_virtual/bootloader = "u-boot-em"

# Set DDR FIRMWARE
DDR_FIRMWARE_NAME = "lpddr4_pmu_train_1d_imem.bin lpddr4_pmu_train_1d_dmem.bin lpddr4_pmu_train_2d_imem.bin lpddr4_pmu_train_2d_dmem.bin"

UBOOT_SUFFIX = "bin"

# Strictly speaking, this isn't (just) the SPL, but we can get the
# U-Boot recipe to deploy the correct files without having to extend
# do_install/do_deploy this way.
SPL_BINARY = "flash.bin"

UBOOT_MAKE_TARGET = "${UBOOT_BINARY} ${SPL_BINARY}"

TFA_PLATFORM = "imx8mn"
TFA_BUILD_TARGET = "bl31"
COMPATIBLE_MACHINE:pn-trusted-firmware-a = "^mx8mn$"
```
