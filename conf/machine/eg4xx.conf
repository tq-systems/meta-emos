## conf/machine/eg4xx.conf
```bitbake
# SPDX-License-Identifier: MIT
#
# Copyright (C) 2026 TQ-Systems GmbH <oss@ew.tq-group.com>, D-82229 Seefeld, Germany.
# Author: Michael Krummsdorf

#@TYPE: Machine
#@NAME: TQ EG4xx
#@SOC: i.MX8M Nano
#@DESCRIPTION: Machine configuration for bootloaders of TQ Energymanager EG4xx

require conf/machine/include/em-mx8mn.inc

PREFERRED_PROVIDER_virtual/kernel = "linux-dummy"

UBOOT_CONFIG = "512m"
UBOOT_CONFIG[512m] = "imx8mn_eg4xx_512m_defconfig"

EXTRA_OEMAKE:append:pn-trusted-firmware-a = " IMX_BOOT_UART_BASE=0x30860000"
```
